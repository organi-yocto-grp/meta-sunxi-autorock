## conf/layer.conf
```bitbake
# We have a conf and classes directory, add to BBPATH
BBPATH .= ":${LAYERDIR}"

# We have recipes-* directories, add to BBFILES
BBFILES += "${LAYERDIR}/recipes-*/*/*.bb \
${LAYERDIR}/recipes-*/*/*.bbappend"

BBFILE_COLLECTIONS += "sunxi-autorock"
BBFILE_PATTERN_sunxi-autorock = "^${LAYERDIR}/"
BBFILE_PRIORITY_sunxi-autorock = "4"
LAYERVERSION_sunxi-autorock = "3"

LAYERDEPENDS_sunxi-autorock = "core autorock"
```

## conf/machine/a20navi-haval-h6-10inch.conf
```bitbake
#@TYPE: Machine
#@NAME: a20navi-haval-h6-10inch
#@SOC: A20
#@DESCRIPTION: Machine configuration for the a20navi, based on allwinner A20 CPU
#@MAINTAINER: chenzilin <chenzilin@autorock.com.cn>

require conf/machine/include/a20navi-common.inc

KERNEL_DEVICETREE = "a20navi-haval-h6-10inch.dtb"

PACKAGECONFIG_remove_pn-pack-img = "splash"
```

## conf/machine/a20navi-huatai-b11.conf
```bitbake
#@TYPE: Machine
#@NAME: a20navi-huatai-b11
#@SOC: A20
#@DESCRIPTION: Machine configuration for the a20navi, based on allwinner A20 CPU
#@MAINTAINER: Qiang Yu <yuqiang@autorock.com.cn>

require conf/machine/include/a20navi-common.inc

KERNEL_DEVICETREE = "a20navi-njgdbus.dtb"
```

## conf/machine/a20navi-njgdbus.conf
```bitbake
#@TYPE: Machine
#@NAME: a20navi-njgdbus
#@SOC: A20
#@DESCRIPTION: Machine configuration for the a20navi, based on allwinner A20 CPU
#@MAINTAINER: Qiang Yu <yuqiang@autorock.com.cn>

require conf/machine/include/a20navi-common.inc

#KERNEL_MODULE_AUTOLOAD += "ntfs"
#MACHINE_ESSENTIAL_EXTRA_RRECOMMENDS += " \
#kernel-module-ntfs \
#"
```

## conf/machine/a20navi.conf
```bitbake
#@TYPE: Machine
#@NAME: a20navi
#@SOC: A20
#@DESCRIPTION: Machine configuration for the a20navi, based on allwinner A20 CPU
#@MAINTAINER: Qiang Yu <yuqiang@autorock.com.cn>

require conf/machine/include/a20navi-common.inc

# K9F4G08U0A
MKUBIFS_ARGS = "-m 2048 -e 126976 -c 2048 -x zlib"

KERNEL_DEVICETREE = "a20navi-njgdbus.dtb"

UBOOT_CONFIG ??= "nand"
UBOOT_CONFIG[sd] = "EP1000A_MMC_NODATA_config"
UBOOT_CONFIG[nand] = "EP1000A_NODATA_config"

MACHINE_FEATURES_remove += "rtc"
```

## conf/machine/include/a20navi-common.inc
```bitbake
require conf/machine/include/tune-cortexa7.inc
require conf/machine/include/sunxi.inc
require conf/machine/include/sunxi-mali.inc

DEFAULTTUNE = "cortexa7hf-neon-vfpv4"

SERIAL_CONSOLE = "115200 ttyS0"

PREFERRED_PROVIDER_u-boot = "u-boot-sunxi-autorock"
PREFERRED_PROVIDER_virtual/kernel = "linux-sunxi-autorock"
PREFERRED_VERSION_linux-libc-headers = ""

PREFERRED_PROVIDER_jpeg = "libjpeg-turbo"

IMAGE_FSTYPES = "tar.bz2"

MACHINE_FEATURES_remove = "usbgadget alsa touchscreen"

# remove getty tty* from /etc/inittab
USE_VT = "0"

SPL_BINARY = "sunxi-spl.bin"
UBOOT_SUFFIX = "bin"
UBOOT_MAKE_TARGET = "all"

MACHINE_SOCARCH = "${TUNE_PKGARCH}-sunxi"
PACKAGE_EXTRA_ARCHS_append = " ${MACHINE_SOCARCH}"

UBOOT_ENTRYPOINT = "0x48000000"

# K9F4G08U0A
MKUBIFS_ARGS = "-m 2048 -e 126976 -c 2048 -x zlib"

KERNEL_DEVICETREE = "a20navi-njgdbus.dtb"

UBOOT_CONFIG ??= "nand"
UBOOT_CONFIG[sd] = "EP1000A_MMC_NODATA_config"
UBOOT_CONFIG[nand] = "EP1000A_NODATA_config"

MACHINE_FEATURES_remove += "rtc"

KERNEL_MODULE_AUTOLOAD += "ntfs"
MACHINE_ESSENTIAL_EXTRA_RRECOMMENDS += " \
kernel-module-ntfs \
"

MACHINEOVERRIDES = "a20navi:${MACHINE}"
MACHINE_CLASS = "a20navi"
```
